#include <reg52.h>
#include <intrins.h>
/**************************************************************************************
*****      间隔300ms先奇数亮再偶数亮，循环三次；												   ************
*****      一个灯上下循环三次；两个分别从两边往中间流动三次								 ************
*****      8个全部闪烁3次；关闭发光管，程序停止。													 ************
**************************************************************************************/
#define uint unsigned int
#define uchar unsigned char
	
void delay(uint a)
{
	while(a--);
}

void main()
{
	uchar temp = 0xfe;
	uint i,j;
	P2=0xaa;
	for(i=0;i<6;i++)//间隔300ms先奇数亮再偶数亮，循环三次
	{
		delay(65535);
		P2=~P2;
	}
	for(i=0;i<3;i++)// 一个灯上下循环三次
	{
		P2=temp;
		for(j=0;j<7;j++)
		{
			delay(20000);
			P2=_crol_(P2,1);
		}
			for(j=0;j<7;j++)
		{
			delay(20000);
			P2=_cror_(P2,1);
		}
	}
	for(j=0;j<3;j++) //从两边往中间流
	{
	P2=0x7e; 
	delay(20000);
	P2=0xbd;
	delay(20000);
	P2=0xdb; 
	delay(20000); 
	P2=0xe7;
	delay(20000); 
	P2=0xff;
	}
	for(i=0;i<6;i++)// 8个全部闪烁3次
	{
		delay(40000);
		P2=~P2;
	}
}