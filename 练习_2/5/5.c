#include <reg52.h>
/***********************************************************************
***        8个发光管间隔200ms由上至下，再由下至上，再重复一次，	     ***
***        然后全部熄灭再以300ms间隔全部闪烁5次。重复此过程。  		   ***
***********************************************************************/
#include <intrins.h>
#define uint unsigned int
	
void delay(uint a)
{
	while(a--);
}

void main()
{
	int i=0, j=0;
	while(1)
	{
		for(i=0; i<2; i++)
		{
			P2=0xfe;
			for (j=0;j<7;j++)//本来就有一个灯亮，所以只需移动8-1次
			{
				delay(44500);
				P2=_crol_(P2,1);
			}
			for (j=0;j<7;j++)
			{
				delay(44500);
				P2=_cror_(P2,1);				
			}
		}
		P2=0xff;
		for(i=0;i<11;i++)
		{
			delay(65534);
			delay(300);
			P2=~P2;
		}
	}
}
